## uboot-port/board/ubiquiti/us48/Kconfig
```kconfig
if TARGET_US48

config SYS_BOARD
	default "us48"

config SYS_VENDOR
	default "ubiquiti"

config SYS_CONFIG_NAME
	default "us48"

config US48_A2
	bool "Target is unit 1's Cortex-A9 (a2), loaded into its carveout by us48_a2 (docs/a2-uboot.md, #83)"
	help
	  RAM = hwdb a2_carveout minus a2_shared (generated DT), DCC console, no unit 0 peripherals.

config US48_PCIE
	bool "Unit 0 PCIe root complex bring-up (pcie.c)"
	default y

config US48_FAN
	bool "Fans, LM75 and PVTMON at boot (fan.c, unit 0 only)"
	default y

config US48_FAN_BOOT_LEVEL
	int "Fan preset applied at boot (0 = 50 %, 1 = 70 %, 2 = 90 %, 3 = 100 %)"
	depends on US48_FAN
	default 0
	range 0 3
	help
	  Dan 2026-11-16: quiet rule by default (0); 3 = 100 % (docs/fan.md). Emergency logic is independent.

config US48_ARM_SP805
	bool "Arm the SP805 watchdog before the CPU clock switch if it is not running"
	default y

config US48_L2
	bool "Enable the PL310 L2 cache with the D-cache; flushed and disabled before the next stage"
	default y if US48_A2
	select SYS_L2_PL310
	help
	  Off for unit 0 (corruption with Linux at 1550 MHz, #17). a2: untested at 1000 MHz (#83).

config US48_CPU_MHZ
	int "A9 clock set by uboot-2 at early init (100, 400, 800, or 1000..1999)"
	default 400
	range 100 1999
	help
	  100 / 400 = no change (a2 power-on / unit 0 entry). 800 = fid 7 (docs/clocks.md E1). 1000..1999 = relock (E2),
	  ndiv = MHz x 2 / 25, so MHz x 2 must be a multiple of 25 (50 MHz steps are).
	  Above 1200 (VCO 2400) no Broadcom table row exists: docs/clock-audit.md.
	  Refuses and stays at 400 if the E0 gate fails. Other values: build error.

config US48_CPU_REENTRY
	bool "Entered with the A9 already switched up (RAM-boot variants chained from a fast awto-uboot)"
	default n
	help
	  Relaxes the E0 gate (fid 6/7, any start rate); needs US48_CPU_MHZ 1000..1999 (relock).
	  For clock sweeps: docs/cpu-sweep.md. Never for the flash image (cold entry is at 400).

config US48_STOCKBOOT
	bool "us48stock command: read kernel1 (read-only) and bootm stock from RAM (#78)"
	default n
	help
	  RAM-load variant only, never flashed (build_uboot.py --stock). Reads kernel1 with sf read, sets stock's bootargs,
	  stops the SP805 (stock has no feeder) and boots it. Writes nothing. Power cycle returns to the normal auto-chain.

config US48_STOCK_NO_U1
	bool "Stock variant: no unit 1 access before us48stock (#78 clean control)"
	depends on US48_STOCKBOOT
	default n
	help
	  Skips the PCIe bring-up (no PERST# cycle), the unit 1 CMIC probe/marker and all fan frames (they need unit 1).
	  xe1 and `bcm_cmic 1` refuse (us48_pcie_up false). Unit 0 untouched (TFTP). RAM-only, never flashed.

config US48_ICACHE
	bool "Enable the L1 I-cache after relocation (#75)"
	default y
	help
	  Switch off if a board test fails. L2 (PL310) is never enabled here (#17).

config US48_DCACHE
	bool "Enable the L1 D-cache + MMU after relocation (#75)"
	default y
	help
	  DRAM cached write-back, everything else strongly ordered, CMIC DMA windows uncached.
	  Switch off if a board test fails. L2 (PL310) is never enabled here (#17).

config US48_SRAM_CLK
	bool "Run the CPU clock switch from SRAM with rollback (docs/sram-clock-switch.md)"
	default n
	help
	  UNTESTED. Replaces the DDR-resident E1/E2 code in board.c.

config US48_SRAM_CLK_GENPLL
	bool "Enable GENPLL ch3/ch4 (AXI) SRAM entry point - DISABLED by default, high risk"
	depends on US48_SRAM_CLK
	default n
	help
	  UNTESTED. docs/clocks.md E5. No caller in the tree; changes AXI clock.

endif
```

## uboot-port/configs/us48_a2_defconfig
```kconfig
CONFIG_ARM=y
CONFIG_TARGET_US48=y
CONFIG_US48_A2=y
CONFIG_TEXT_BASE=0x08000000
CONFIG_SYS_MALLOC_LEN=0x200000
CONFIG_SYS_MALLOC_F_LEN=0x8000
CONFIG_NR_DRAM_BANKS=1
CONFIG_HAS_CUSTOM_SYS_INIT_SP_ADDR=y
CONFIG_CUSTOM_SYS_INIT_SP_ADDR=0x08200000
CONFIG_DEFAULT_DEVICE_TREE="us48-a2"
CONFIG_SYS_LOAD_ADDR=0x09000000
CONFIG_SKIP_LOWLEVEL_INIT=y
CONFIG_IDENT_STRING=" us48-a2"
# CONFIG_EFI_LOADER is not set
# CONFIG_BOOTSTD is not set
CONFIG_BOOTDELAY=-1
CONFIG_BOARD_INIT=y
CONFIG_BOARD_EARLY_INIT_F=y
CONFIG_US48_CPU_MHZ=1000
CONFIG_US48_CPU_REENTRY=y
# CONFIG_US48_PCIE is not set
# CONFIG_US48_FAN is not set
# CONFIG_US48_ARM_SP805 is not set
CONFIG_US48_L2=y
# CONFIG_DISPLAY_CPUINFO is not set
CONFIG_ARM_DCC=y
CONFIG_OF_STDOUT_VIA_ALIAS=y
CONFIG_HUSH_PARSER=y
CONFIG_SYS_PROMPT="awto-uboot> "
CONFIG_CMD_BOOTZ=y
CONFIG_CMD_CACHE=y
CONFIG_CMD_CRC32=y
# CONFIG_BCM_CMIC is not set
# CONFIG_NET is not set
CONFIG_ENV_IS_NOWHERE=y
CONFIG_CLK=y
CONFIG_SYS_BOOTM_LEN=0x1000000
# CONFIG_TOOLS_LIBCRYPTO is not set
# CONFIG_TOOLS_KWBIMAGE is not set
# CONFIG_FIT_SIGNATURE is not set
```
