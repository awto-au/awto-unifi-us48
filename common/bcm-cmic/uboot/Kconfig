## common/bcm-cmic/uboot/Kconfig
```kconfig
# SPDX-License-Identifier: GPL-2.0
config BCM_CMIC
	bool "Broadcom CMIC shared core (S-channel, MIIM)"
	help
	  Core shared with Linux, staged from common/bcm-cmic/ by sync_bcm_cmic.py.

config BCM_CMIC_UNIT0_BASE
	hex "Unit 0 CMIC base address"
	depends on BCM_CMIC
	default 0x48000000
	help
	  BCM53344 CMIC on AXI (docs/driver-internals.md section 8).

config BCM_CMIC_UNIT1_BASE
	hex "Unit 1 CMIC base address (PCIe BAR2 as stock U-Boot enumerates it)"
	depends on BCM_CMIC
	default 0x08040000

config US48_CMIC_ETH
	bool "US-48 BCM53346 xe1 (front 50) Ethernet, polled"
	depends on BCM_CMIC && DM_ETH
	default y

config CMD_BCM_CMIC
	bool "cmic, schan, smem, miim: read-only CMIC examination commands"
	depends on BCM_CMIC
	default y
```

## mainline/us48_defconfig
```kconfig
# US-48-500W mainline: used with `make allnoconfig` (KCONFIG_ALLCONFIG), every other symbol is off (#64)
# Platform: BCM53344 HR2, one Cortex-A9, no VFP, SMP off
CONFIG_MMU=y
CONFIG_ARCH_MULTIPLATFORM=y
CONFIG_ARCH_MULTI_V7=y
CONFIG_ARCH_BCM=y
CONFIG_ARCH_BCM_HR2=y
# CONFIG_SMP is not set
CONFIG_ARM_THUMB=y
CONFIG_HIGHMEM=y
CONFIG_CMA=y
CONFIG_DMA_CMA=y
CONFIG_HZ_100=y
CONFIG_KUSER_HELPERS=y
CONFIG_HARDEN_BRANCH_PREDICTOR=y
CONFIG_HARDEN_BRANCH_HISTORY=y
CONFIG_CACHE_L2X0=y
CONFIG_PL310_ERRATA_588369=y
CONFIG_PL310_ERRATA_727915=y
CONFIG_PL310_ERRATA_753970=y
CONFIG_PL310_ERRATA_769419=y
CONFIG_ARM_ERRATA_430973=y
CONFIG_ARM_ERRATA_720789=y
CONFIG_ARM_ERRATA_754322=y
CONFIG_ARM_ERRATA_775420=y
CONFIG_ARM_ERRATA_814220=y
CONFIG_ARM_GIC=y
CONFIG_ARM_GLOBAL_TIMER=y
CONFIG_ARM_TIMER_SP804=y
CONFIG_COMMON_CLK=y
CONFIG_CLK_BCM_HR2=y
# Boot: appended DTB, initramfs, cmdline from the DTB/kernel
CONFIG_ARM_APPENDED_DTB=y
# CONFIG_ARM_ATAG_DTB_COMPAT is not set
CONFIG_CMDLINE="console=ttyS0,115200 earlycon keep_bootcon cma=8M@64M-128M"
CONFIG_BLK_DEV_INITRD=y
CONFIG_RD_GZIP=y
CONFIG_KERNEL_GZIP=y
CONFIG_INITRAMFS_COMPRESSION_GZIP=y
# Core / OpenWrt userspace (procd, ubus, netifd, dropbear, dnsmasq, odhcpd, sysntpd, urngd)
CONFIG_EXPERT=y
CONFIG_PRINTK=y
CONFIG_BUG=y
CONFIG_MULTIUSER=y
CONFIG_FILE_LOCKING=y
CONFIG_FUTEX=y
CONFIG_EPOLL=y
CONFIG_SIGNALFD=y
CONFIG_TIMERFD=y
CONFIG_EVENTFD=y
CONFIG_SHMEM=y
CONFIG_ADVISE_SYSCALLS=y
CONFIG_POSIX_TIMERS=y
CONFIG_INOTIFY_USER=y
CONFIG_BINFMT_ELF=y
CONFIG_BINFMT_SCRIPT=y
CONFIG_PROC_FS=y
CONFIG_SYSFS=y
CONFIG_TMPFS=y
CONFIG_DEVTMPFS=y
CONFIG_DEVTMPFS_MOUNT=y
CONFIG_TTY=y
CONFIG_UNIX98_PTYS=y
CONFIG_DEVMEM=y
# CONFIG_STRICT_DEVMEM is not set
CONFIG_SYSCTL=y
CONFIG_BLOCK=y
CONFIG_MISC_FILESYSTEMS=y
CONFIG_SQUASHFS=y
CONFIG_SQUASHFS_ZLIB=y
CONFIG_SQUASHFS_XZ=y
CONFIG_MODULES=y
CONFIG_MODULE_UNLOAD=y
# Networking: us48_cmic is a plain netdev driver; no netfilter (no firewall in the image)
CONFIG_NET=y
CONFIG_UNIX=y
CONFIG_PACKET=y
CONFIG_INET=y
CONFIG_IP_MULTICAST=y
CONFIG_IP_ADVANCED_ROUTER=y
CONFIG_IP_MULTIPLE_TABLES=y
CONFIG_IPV6=y
CONFIG_IPV6_MULTIPLE_TABLES=y
CONFIG_BRIDGE=y
CONFIG_BRIDGE_IGMP_SNOOPING=y
CONFIG_VLAN_8021Q=y
CONFIG_NET_CORE=y
CONFIG_NETDEVICES=y
CONFIG_ETHERNET=y
CONFIG_TUN=y
# Hardware
CONFIG_SERIAL_8250=y
CONFIG_SERIAL_8250_CONSOLE=y
CONFIG_SERIAL_OF_PLATFORM=y
CONFIG_SERIAL_EARLYCON=y
CONFIG_HW_RANDOM=y
CONFIG_HW_RANDOM_BCM2835=y
CONFIG_PCI=y
CONFIG_PCI_MSI=y
CONFIG_PCI_QUIRKS=y
CONFIG_PCIEASPM=y
CONFIG_PCIEASPM_DEFAULT=y
CONFIG_PCIE_IPROC_PLATFORM=y
CONFIG_PCIE_IPROC_MSI=y
CONFIG_SPI=y
CONFIG_SPI_MEM=y
CONFIG_SPI_BCM_QSPI=y
CONFIG_MTD=y
CONFIG_MTD_OF_PARTS=y
CONFIG_MTD_SPI_NOR=y
CONFIG_MTD_SPI_NOR_USE_4K_SECTORS=y
CONFIG_I2C=y
CONFIG_I2C_CHARDEV=y
CONFIG_I2C_BCM_IPROC=y
CONFIG_I2C_MUX=y
CONFIG_I2C_MUX_PCA954x=y
CONFIG_HWMON=y
CONFIG_SENSORS_LM75=y
CONFIG_WATCHDOG=y
CONFIG_ARM_SP805_WATCHDOG=y
CONFIG_GPIOLIB=y
CONFIG_PINCTRL_IPROC_GPIO=y
CONFIG_MFD_SYSCON=y
CONFIG_POWER_RESET=y
CONFIG_POWER_RESET_SYSCON=y
# Debug profile for the switch-driver work (#4), same set as OpenWrt hr2/config-6.18
CONFIG_DEBUG_KERNEL=y
CONFIG_DEBUG_FS=y
CONFIG_DEBUG_FS_ALLOW_ALL=y
CONFIG_DYNAMIC_DEBUG=y
CONFIG_DEBUG_ATOMIC_SLEEP=y
CONFIG_DEBUG_LIST=y
CONFIG_DEBUG_MUTEXES=y
CONFIG_DEBUG_SPINLOCK=y
CONFIG_DETECT_HUNG_TASK=y
CONFIG_SCHED_STACK_END_CHECK=y
CONFIG_FTRACE=y
CONFIG_EVENT_TRACING=y
CONFIG_KPROBES=y
CONFIG_KPROBE_EVENTS=y
CONFIG_PERF_EVENTS=y
CONFIG_KALLSYMS=y
CONFIG_KALLSYMS_ALL=y
CONFIG_IKCONFIG=y
CONFIG_IKCONFIG_PROC=y
CONFIG_MAGIC_SYSRQ=y
CONFIG_MAGIC_SYSRQ_SERIAL=y
CONFIG_PRINTK_TIME=y
CONFIG_LOCALVERSION_AUTO=y
```

## uboot-port/board/ubiquiti/us48/Kconfig
```kconfig
if TARGET_US48

config SYS_BOARD
	default "us48"

config SYS_VENDOR
	default "ubiquiti"

config SYS_CONFIG_NAME
	default "us48"

config US48_CPU_MHZ
	int "A9 clock set by uboot-2 at early init (400, 800, or 1000..1999)"
	default 400
	range 400 1999
	help
	  400 = no change. 800 = fid 7 (docs/clocks.md E1). 1000..1999 = relock (E2),
	  ndiv = MHz x 2 / 25, so MHz x 2 must be a multiple of 25 (50 MHz steps are).
	  Above 1200 (VCO 2400) no Broadcom table row exists: docs/clock-audit.md.
	  Refuses and stays at 400 if the E0 gate fails. Other values: build error.

config US48_SRAM_CLK
	bool "Run the CPU clock switch from SRAM with rollback (docs/sram-clock-switch.md)"
	default n
	help
	  UNTESTED. Replaces the DDR-resident E1/E2 code in board.c.

config US48_SRAM_CLK_GENPLL
	bool "Enable GENPLL ch3/ch4 (AXI) SRAM entry point - DISABLED by default, high risk"
	depends on US48_SRAM_CLK
	default n
	help
	  UNTESTED. docs/clocks.md E5. No caller in the tree; changes AXI clock.

endif
```

## uboot-port/configs/us48_defconfig
```kconfig
CONFIG_ARM=y
CONFIG_TARGET_US48=y
CONFIG_TEXT_BASE=0x04000000
CONFIG_SYS_MALLOC_LEN=0x400000
CONFIG_SYS_MALLOC_F_LEN=0x8000
CONFIG_NR_DRAM_BANKS=2
CONFIG_HAS_CUSTOM_SYS_INIT_SP_ADDR=y
CONFIG_CUSTOM_SYS_INIT_SP_ADDR=0x03f00000
CONFIG_DEFAULT_DEVICE_TREE="us48-uboot"
CONFIG_SYS_LOAD_ADDR=0x01000000
CONFIG_SKIP_LOWLEVEL_INIT=y
CONFIG_IDENT_STRING=" us48"
# CONFIG_EFI_LOADER is not set
# CONFIG_BOOTSTD is not set
CONFIG_BOOTDELAY=-1
CONFIG_BOARD_INIT=y
CONFIG_BOARD_EARLY_INIT_F=y
CONFIG_US48_CPU_MHZ=1550
# CONFIG_DISPLAY_CPUINFO is not set
CONFIG_OF_STDOUT_VIA_ALIAS=y
CONFIG_HUSH_PARSER=y
CONFIG_SYS_PROMPT="awto-uboot> "
CONFIG_CMD_BOOTZ=y
CONFIG_CMD_LOADB=y
CONFIG_CMD_CACHE=y
CONFIG_CMD_WDT=y
CONFIG_CMD_CRC32=y
CONFIG_CMD_SF=y
CONFIG_BCM_CMIC=y
CONFIG_NET=y
CONFIG_NETDEVICES=y
CONFIG_DM_ETH=y
CONFIG_US48_CMIC_ETH=y
CONFIG_CMD_NET=y
CONFIG_CMD_DHCP=y
CONFIG_CMD_PING=y
CONFIG_CMD_TFTPBOOT=y
CONFIG_USE_IPADDR=y
CONFIG_IPADDR="192.168.25.207"
CONFIG_USE_NETMASK=y
CONFIG_NETMASK="255.255.255.0"
CONFIG_USE_GATEWAYIP=y
CONFIG_GATEWAYIP="192.168.25.254"
CONFIG_USE_SERVERIP=y
CONFIG_SERVERIP="192.168.25.30"
CONFIG_ENV_IS_NOWHERE=y
CONFIG_CLK=y
CONFIG_SYSCON=y
CONFIG_WDT=y
CONFIG_WATCHDOG=y
CONFIG_WATCHDOG_TIMEOUT_MSECS=10000
CONFIG_WDT_SP805=y
CONFIG_MTD=y
CONFIG_SPI=y
CONFIG_DM_SPI=y
CONFIG_IPROC_QSPI=y
CONFIG_SPI_FLASH=y
CONFIG_DM_SPI_FLASH=y
CONFIG_SPI_FLASH_MACRONIX=y
CONFIG_SYS_BOOTM_LEN=0x1000000
CONFIG_SUPPORT_PASSING_ATAGS=y
CONFIG_SETUP_MEMORY_TAGS=y
CONFIG_CMDLINE_TAG=y
CONFIG_SF_DEFAULT_SPEED=12500000
CONFIG_SF_DEFAULT_MODE=0x3
# CONFIG_SPI_FLASH_UNLOCK_ALL is not set
# CONFIG_SPI_FLASH_LOCK is not set
# CONFIG_CMD_SF_TEST is not set
CONFIG_SYSRESET=y
CONFIG_SYSRESET_SYSCON=y
# CONFIG_TOOLS_LIBCRYPTO is not set
# CONFIG_TOOLS_KWBIMAGE is not set
# CONFIG_FIT_SIGNATURE is not set
CONFIG_TFTP_BLOCKSIZE=1468
CONFIG_TFTP_WINDOWSIZE=8
```
